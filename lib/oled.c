#include <stdio.h>
#include <stdlib.h>
#include <stdarg.h>
#include <string.h>

#include "oled.h"

#define USE_HAL_SPI 0

uint8_t oled_rotated;
uint32_t font_color;

/* buffer of symbols being displayed */
static uint8_t oled_sym[OLED_DIGITS];

/** OLED frame buffer */
uint8_t oled_frame[OLED_LINE_SIZE * OLED_FONT_HEIGHT];

static void spi_send_byte(uint8_t data)
{
#if USE_HAL_SPI
	HAL_SPI_Transmit(&hspi, (uint8_t *)&data, 1, HAL_MAX_DELAY);
#else
	while(!(spi->SR & SPI_SR_TXE)); /* make sure that data register is available for write */
	spi->DR = data;
#endif
}

/* send single-byte command to SH1122 */
void oled_send_cmd(uint8_t cmd)
{
	oled_cs_select();
	oled_dc_cmd();
	spi_send_byte(cmd);
	while(spi->SR & SPI_SR_BSY); /* make sure that command is sent before unselecting */
	oled_cs_unselect();
}

/* send double-byte command to SH1122 */
void oled_send_cmd_arg(uint8_t cmd, uint8_t arg)
{
	oled_cs_select();
	oled_dc_cmd();
	spi_send_byte(cmd);
    spi_send_byte(arg);
	while(spi->SR & SPI_SR_BSY); /* make sure that command is sent before unselecting */
	oled_cs_unselect();
}

void oled_send_data(uint8_t *data, uint16_t len)
{
	oled_cs_select();
	oled_dc_data();
	for (uint16_t i = 0; i < len; i ++)
		spi_send_byte(data[i]);
	while(spi->SR & SPI_SR_BSY); /* make sure that data is sent before unselecting */
	oled_cs_unselect();
}

/** reset display */
void oled_reset(void)
{
	oled_rst_start();
	delay_usec(20);
	oled_rst_stop();
	delay_usec(100);
}

void oled_set_font_color(uint8_t color)
{
	color = (color << 4) | (color & 0x0F);
	/**
	 * convert 4 bit grayscale to 32 bit mask for font
	 * font stores color as 0x0F, so mask can convert it to any color
	 */
	uint32_t new_color = (color << 24) | (color << 16) | (color << 8) | color;
	if (new_color != font_color) {
		font_color = new_color;
		/* force re-drawing of the frame buffer */
		memset(oled_sym, SYM_MAX, sizeof(oled_sym));
	}
}

void oled_clear_ram(uint8_t fill)
{
	/* clear SH1122 RAM */
	oled_cs_select();
	oled_dc_data();
	fill = (fill & 0x0F) | (fill << 4);
	for (uint16_t i = 0; i < OLED_WIDTH * OLED_HEIGHT / OLED_PPB; i++)
		spi_send_byte(fill);
	while(spi->SR & SPI_SR_BSY); /* make sure that data is sent before unselecting */
	oled_cs_unselect();
	return;
}

void oled_clear_frame(uint8_t fill)
{
	fill = (fill & 0x0F) | (fill << 4);
	memset(oled_frame, fill, sizeof(oled_frame));
	memset(oled_sym, SYM_MAX, sizeof(oled_sym));
	return;
}

void oled_init(uint8_t fill)
{
	oled_reset();
	sh1122_set_oled_on(false); /* oled off */
	sh1122_set_dc_dc(SH1122_DC_DC_EXTERNAL, SH1122_DC_DC_FREQ_06SF);
	oled_rotated = 0;
	oled_set_font_color(OLED_DEFAULT_FONT_COLOR);
	oled_clear_frame(fill);
	oled_clear_ram(fill);
	sh1122_set_oled_on(true);
	delay(10);
	return;
}

void oled_rotate(bool rotated)
{
	sh1122_set_flip(rotated);
	sh1122_set_remap(rotated ? SH1122_CMD_SET_DIR_REVERSE : SH1122_CMD_SET_DIR_NORMAL);
	sh1122_set_row(rotated ? 32 : 0);
	oled_rotated = !!rotated;
}

/** use specified color to draw a pixel at the given position */
void oled_set_pixel(uint16_t x, uint16_t y, uint8_t color)
{
	if (y < OLED_FONT_HEIGHT) {
		uint16_t pos = x / OLED_PPB + y * (OLED_WIDTH / OLED_PPB);
		uint8_t data = oled_frame[pos];
		if (x & 0x01)
			data = (data & 0xF0) | color;
		else
			data = (data & 0x0F) | (color << 4);
		oled_frame[pos] = data;
	}
}

/** draw horizontal line */
void oled_draw_line(uint8_t x, uint8_t y, uint16_t len, uint8_t color)
{
	for (uint16_t i = 0; i < len; i++)
		oled_set_pixel(x + i, y, color);
}

/** draw vertical line */
void oled_draw_row(uint8_t x, uint8_t y, uint8_t hight, uint8_t color)
{
	for (uint8_t i = 0; i < hight; i++)
		oled_set_pixel(x, y + i, color);
}

/* symbols, supported by MK-52 */
static const uint8_t digit_space[] = {
	0x00, 0x00, 0x00, 0x00, 0x00, 0x00, 0x00, 0x00, 0x00, 0x00, 0x00, /*   0  */
	0x00, 0x00, 0x00, 0x00, 0x00, 0x00, 0x00, 0x00, 0x00, 0x00, 0x00, /*   1  */
	0x00, 0x00, 0x00, 0x00, 0x00, 0x00, 0x00, 0x00, 0x00, 0x00, 0x00, /*   2  */
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	0x00, 0x00, 0x00, 0x00, 0x00, 0x00, 0x00, 0x00, 0x00, 0x00, 0x00, /*  34  */
};

static const uint8_t digit_minus[] = {
	0x00, 0x00, 0x00, 0x00, 0x00, 0x00, 0x00, 0x00, 0x00, 0x00, 0x00, /*   0  */
	0x00, 0x00, 0x00, 0x00, 0x00, 0x00, 0x00, 0x00, 0x00, 0x00, 0x00, /*   1  */
	0x00, 0x00, 0x00, 0x00, 0x00, 0x00, 0x00, 0x00, 0x00, 0x00, 0x00, /*   2  */
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	0x00, 0x00, 0x00, 0x00, 0x00, 0x00, 0x00, 0x00, 0x00, 0x00, 0x00, /*  34  */
};

static const uint8_t digit_0[] = {
	0x00, 0x00, 0xFF, 0xFF, 0xFF, 0xFF, 0xFF, 0x00, 0x00, 0x00, 0x00, /*   0  */
	0x00, 0x0F, 0xFF, 0xFF, 0xFF, 0xFF, 0xFF, 0xF0, 0x00, 0x00, 0x00, /*   1  */
	0x0F, 0x00, 0xFF, 0xFF, 0xFF, 0xFF, 0xFF, 0x00, 0xF0, 0x00, 0x00, /*   2  */
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	0x00, 0x00, 0xFF, 0xFF, 0xFF, 0xFF, 0xFF, 0x00, 0x00, 0x00, 0x00, /*  34  */
};

static const uint8_t digit_1[] = {
	0x00, 0x00, 0x00, 0x00, 0x00, 0x00, 0x00, 0x00, 0x00, 0x00, 0x00, /*   0  */
	0x00, 0x00, 0x00, 0x00, 0x00, 0x00, 0x00, 0x00, 0x00, 0x00, 0x00, /*   1  */
	0x00, 0x00, 0x00, 0x00, 0x00, 0x00, 0x00, 0x00, 0xF0, 0x00, 0x00, /*   2  */
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	0x00, 0x00, 0x00, 0x00, 0x00, 0x00, 0x00, 0x00, 0x00, 0x00, 0x00, /*  34  */
};

static const uint8_t digit_2[] = {
	0x00, 0x00, 0xFF, 0xFF, 0xFF, 0xFF, 0xFF, 0x00, 0x00, 0x00, 0x00, /*   0  */
	0x00, 0x0F, 0xFF, 0xFF, 0xFF, 0xFF, 0xFF, 0xF0, 0x00, 0x00, 0x00, /*   1  */
	0x00, 0x00, 0xFF, 0xFF, 0xFF, 0xFF, 0xFF, 0x00, 0xF0, 0x00, 0x00, /*   2  */
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	0x00, 0x00, 0xFF, 0xFF, 0xFF, 0xFF, 0xFF, 0x00, 0x00, 0x00, 0x00, /*  34  */
};

static const uint8_t digit_3[] = {
	0x00, 0x00, 0xFF, 0xFF, 0xFF, 0xFF, 0xFF, 0x00, 0x00, 0x00, 0x00, /*   0  */
	0x00, 0x0F, 0xFF, 0xFF, 0xFF, 0xFF, 0xFF, 0xF0, 0x00, 0x00, 0x00, /*   1  */
	0x00, 0x00, 0xFF, 0xFF, 0xFF, 0xFF, 0xFF, 0x00, 0xF0, 0x00, 0x00, /*   2  */
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	0x00, 0x00, 0xFF, 0xFF, 0xFF, 0xFF, 0xFF, 0x00, 0x00, 0x00, 0x00, /*  34  */
};

static const uint8_t digit_4[] = {
	0x00, 0x00, 0x00, 0x00, 0x00, 0x00, 0x00, 0x00, 0x00, 0x00, 0x00, /*   0  */
	0x00, 0x00, 0x00, 0x00, 0x00, 0x00, 0x00, 0x00, 0x00, 0x00, 0x00, /*   1  */
	0x0F, 0x00, 0x00, 0x00, 0x00, 0x00, 0x00, 0x00, 0xF0, 0x00, 0x00, /*   2  */
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	0x00, 0x00, 0x00, 0x00, 0x00, 0x00, 0x00, 0x00, 0x00, 0x00, 0x00, /*  34  */
};

static const uint8_t digit_5[] = {
	0x00, 0x00, 0xFF, 0xFF, 0xFF, 0xFF, 0xFF, 0x00, 0x00, 0x00, 0x00, /*   0  */
	0x00, 0x0F, 0xFF, 0xFF, 0xFF, 0xFF, 0xFF, 0xF0, 0x00, 0x00, 0x00, /*   1  */
	0x0F, 0x00, 0xFF, 0xFF, 0xFF, 0xFF, 0xFF, 0x00, 0x00, 0x00, 0x00, /*   2  */
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	0x00, 0x00, 0xFF, 0xFF, 0xFF, 0xFF, 0xFF, 0x00, 0x00, 0x00, 0x00, /*  34  */
};

static const uint8_t digit_6[] = {
	0x00, 0x00, 0xFF, 0xFF, 0xFF, 0xFF, 0xFF, 0x00, 0x00, 0x00, 0x00, /*   0  */
	0x00, 0x0F, 0xFF, 0xFF, 0xFF, 0xFF, 0xFF, 0xF0, 0x00, 0x00, 0x00, /*   1  */
	0x0F, 0x00, 0xFF, 0xFF, 0xFF, 0xFF, 0xFF, 0x00, 0x00, 0x00, 0x00, /*   2  */
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	0x00, 0x00, 0xFF, 0xFF, 0xFF, 0xFF, 0xFF, 0x00, 0x00, 0x00, 0x00, /*  34  */
};

static const uint8_t digit_7[] = {
	0x00, 0x00, 0xFF, 0xFF, 0xFF, 0xFF, 0xFF, 0x00, 0x00, 0x00, 0x00, /*   0  */
	0x00, 0x0F, 0xFF, 0xFF, 0xFF, 0xFF, 0xFF, 0xF0, 0x00, 0x00, 0x00, /*   1  */
	0x00, 0x00, 0xFF, 0xFF, 0xFF, 0xFF, 0xFF, 0x00, 0xF0, 0x00, 0x00, /*   2  */
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	0x00, 0x00, 0x00, 0x00, 0x00, 0x00, 0x00, 0x00, 0x00, 0x00, 0x00, /*  34  */
};

static const uint8_t digit_8[] = {
	0x00, 0x00, 0xFF, 0xFF, 0xFF, 0xFF, 0xFF, 0x00, 0x00, 0x00, 0x00, /*   0  */
	0x00, 0x0F, 0xFF, 0xFF, 0xFF, 0xFF, 0xFF, 0xF0, 0x00, 0x00, 0x00, /*   1  */
	0x0F, 0x00, 0xFF, 0xFF, 0xFF, 0xFF, 0xFF, 0x00, 0xF0, 0x00, 0x00, /*   2  */
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	0x00, 0x00, 0xFF, 0xFF, 0xFF, 0xFF, 0xFF, 0x00, 0x00, 0x00, 0x00, /*  34  */
};

static const uint8_t digit_9[] = {
	0x00, 0x00, 0xFF, 0xFF, 0xFF, 0xFF, 0xFF, 0x00, 0x00, 0x00, 0x00, /*   0  */
	0x00, 0x0F, 0xFF, 0xFF, 0xFF, 0xFF, 0xFF, 0xF0, 0x00, 0x00, 0x00, /*   1  */
	0x0F, 0x00, 0xFF, 0xFF, 0xFF, 0xFF, 0xFF, 0x00, 0xF0, 0x00, 0x00, /*   2  */
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	0x00, 0x00, 0xFF, 0xFF, 0xFF, 0xFF, 0xFF, 0x00, 0x00, 0x00, 0x00, /*  34  */
};

static const uint8_t digit_c[] = {
	0x00, 0x00, 0xFF, 0xFF, 0xFF, 0xFF, 0xFF, 0x00, 0x00, 0x00, 0x00, /*   0  */
	0x00, 0x0F, 0xFF, 0xFF, 0xFF, 0xFF, 0xFF, 0xF0, 0x00, 0x00, 0x00, /*   1  */
	0x0F, 0x00, 0xFF, 0xFF, 0xFF, 0xFF, 0xFF, 0x00, 0x00, 0x00, 0x00, /*   2  */
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	0x00, 0x00, 0xFF, 0xFF, 0xFF, 0xFF, 0xFF, 0x00, 0x00, 0x00, 0x00, /*  34  */
};

static const uint8_t digit_e[] = {
	0x00, 0x00, 0xFF, 0xFF, 0xFF, 0xFF, 0xFF, 0x00, 0x00, 0x00, 0x00, /*   0  */
	0x00, 0x0F, 0xFF, 0xFF, 0xFF, 0xFF, 0xFF, 0xF0, 0x00, 0x00, 0x00, /*   1  */
	0x0F, 0x00, 0xFF, 0xFF, 0xFF, 0xFF, 0xFF, 0x00, 0x00, 0x00, 0x00, /*   2  */
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	0x00, 0x00, 0xFF, 0xFF, 0xFF, 0xFF, 0xFF, 0x00, 0x00, 0x00, 0x00, /*  34  */
};

static const uint8_t digit_l[] = {
	0x00, 0x00, 0x00, 0x00, 0x00, 0x00, 0x00, 0x00, 0x00, 0x00, 0x00, /*   0  */
	0x00, 0x00, 0x00, 0x00, 0x00, 0x00, 0x00, 0x00, 0x00, 0x00, 0x00, /*   1  */
	0x0F, 0x00, 0x00, 0x00, 0x00, 0x00, 0x00, 0x00, 0x00, 0x00, 0x00, /*   2  */
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	0x00, 0x00, 0xFF, 0xFF, 0xFF, 0xFF, 0xFF, 0x00, 0x00, 0x00, 0x00, /*  34  */
};

static const uint8_t digit_r[] = { /* this symbol looks like Russian letter 'Г' */
	0x00, 0x00, 0xFF, 0xFF, 0xFF, 0xFF, 0xFF, 0x00, 0x00, 0x00, 0x00, /*   0  */
	0x00, 0x0F, 0xFF, 0xFF, 0xFF, 0xFF, 0xFF, 0xF0, 0x00, 0x00, 0x00, /*   1  */
	0x0F, 0x00, 0xFF, 0xFF, 0xFF, 0xFF, 0xFF, 0x00, 0x00, 0x00, 0x00, /*   2  */
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	0x00, 0x00, 0x00, 0x00, 0x00, 0x00, 0x00, 0x00, 0x00, 0x00, 0x00, /*  34  */
};

static const uint8_t digit_16[] = { /* actually, this is '-1' in one position, similar to this: '˧' */
	0x00, 0x00, 0x00, 0x00, 0x00, 0x00, 0x00, 0x00, 0x00, 0x00, 0x00, /*   0  */
	0x00, 0x00, 0x00, 0x00, 0x00, 0x00, 0x00, 0x00, 0x00, 0x00, 0x00, /*   1  */
	0x00, 0x00, 0x00, 0x00, 0x00, 0x00, 0x00, 0x00, 0xF0, 0x00, 0x00, /*   2  */
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	0x00, 0x00, 0x00, 0x00, 0x00, 0x00, 0x00, 0x00, 0x00, 0x00, 0x00, /*  34  */
};

static const uint8_t digit_17[] = { /* this symbol looks like '-7' in one position or reversed 'F': 'ꟻ' */
	0x00, 0x00, 0xFF, 0xFF, 0xFF, 0xFF, 0xFF, 0x00, 0x00, 0x00, 0x00, /*   0  */
	0x00, 0x0F, 0xFF, 0xFF, 0xFF, 0xFF, 0xFF, 0xF0, 0x00, 0x00, 0x00, /*   1  */
	0x00, 0x00, 0xFF, 0xFF, 0xFF, 0xFF, 0xFF, 0x00, 0xF0, 0x00, 0x00, /*   2  */
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	0x00, 0x00, 0x00, 0x00, 0x00, 0x00, 0x00, 0x00, 0x00, 0x00, 0x00, /*  34  */
};

static const uint8_t digit_18[] = { /* this symbol looks like reversed 'P': 'ꟼ' */
	0x00, 0x00, 0xFF, 0xFF, 0xFF, 0xFF, 0xFF, 0x00, 0x00, 0x00, 0x00, /*   0  */
	0x00, 0x0F, 0xFF, 0xFF, 0xFF, 0xFF, 0xFF, 0xF0, 0x00, 0x00, 0x00, /*   1  */
	0x0F, 0x00, 0xFF, 0xFF, 0xFF, 0xFF, 0xFF, 0x00, 0xF0, 0x00, 0x00, /*   2  */
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	0x00, 0x00, 0x00, 0x00, 0x00, 0x00, 0x00, 0x00, 0x00, 0x00, 0x00, /*  34  */
};

static const uint8_t digit_sign[] = {
	0x00, 0x00, 0x00, 0x00, 0x00,
	0x00, 0x00, 0x00, 0x00, 0x00,
	0x00, 0x00, 0x00, 0x00, 0x00,

	0xFF, 0xFF, 0xFF, 0xFF, 0xF0,
	0xFF, 0xFF, 0xFF, 0xFF, 0xF0,
	0xFF, 0xFF, 0xFF, 0xFF, 0xF0,
};

static const uint8_t digit_dot[] = {
	0x00, 0x00,
	0x00, 0x00,
	0x00, 0x00,

	0xFF, 0xF0,
	0xFF, 0xF0,
	0xFF, 0xF0,
};

static const uint8_t *font[SYM_MAX] = {
	digit_space, digit_minus,
	/* digits 0 to 9 */
	digit_0, digit_1, digit_2, digit_3,	digit_4,
	digit_5, digit_6, digit_7, digit_8,	digit_9,
	/* some special symbols */
	digit_c, digit_e, digit_l, digit_r,	digit_16,
	digit_17, digit_18
};

/**
 * copy a symbols to the frame buffer
 * @param pos: symbol position 0 to 11, 0: sign, 1: first digit, ..
 * @param sym: high bit: dot is present, lower 7 bits: supported symbol index 0 to 18, or > 18 for number's sign
 * @param color: grayscale index to use, 0 (black) to 15 (brightest white)
 *
 * @return 1 if printed, 0 otherwise
 */
uint8_t oled_print(uint8_t pos, uint8_t sym)
{
	if (pos >= OLED_DIGITS) /* invalid symbol position */
		return 0;

	if (oled_sym[pos] == sym) /* already there, nothing to do */
		return 0;

	uint8_t diff = oled_sym[pos] ^ sym; /* check if difference is the 'dot' only */
	uint8_t dot = sym & SEG_DOT;
	oled_sym[pos] = sym;
	sym &= ~SEG_DOT;

	if (sym >= SYM_MAX) /* invalid symbol */
		return 0;

	const uint8_t *ptr;

	/* the sign symbol */
	if (pos == 0) {
		ptr = digit_sign;
		if (sym == SYM_MINUS)
			ptr += sizeof(digit_sign) / 2;
		for (uint8_t y = 0; y < OLED_FONT_SIGN_HEIGHT; y++) {
			uint16_t pos = OLED_SIGN_LINE * OLED_LINE_SIZE + y * OLED_LINE_SIZE;
			*(uint32_t *)&oled_frame[pos] = *(uint32_t *)ptr & font_color;
			oled_frame[pos + 4] = ptr[4] & font_color;
		}
		return 1;
	}

	/* full-size symbol */
	pos -= 1;
	if (diff != SEG_DOT) {
		ptr = font[sym];
		/* symbols are actually 9 bytes wide, so split 9 bytes to two 32bit + 16bit */
		for (uint8_t y = 0; y < OLED_FONT_CHAR_HEIGHT; y++) {
			uint16_t x = OLED_SYM_OFFSET / OLED_PPB + pos * OLED_FONT_WIDTH / OLED_PPB + y * OLED_LINE_SIZE;
			*(uint32_t *)&oled_frame[x + 0] = *(uint32_t *)&ptr[y * OLED_FONT_WIDTH / OLED_PPB + 0] & font_color;
			*(uint32_t *)&oled_frame[x + 4] = *(uint32_t *)&ptr[y * OLED_FONT_WIDTH / OLED_PPB + 4] & font_color;
			*(uint16_t *)&oled_frame[x + 8] = *(uint16_t *)&ptr[y * OLED_FONT_WIDTH / OLED_PPB + 8] & font_color;
		}
	}

	ptr = digit_dot;
	if (dot)
		ptr += sizeof(digit_dot) / 2;
	for (uint8_t y = 0; y < OLED_FONT_DOT_HEIGHT; y++) {
		uint16_t x = OLED_SYM_OFFSET / OLED_PPB + OLED_DOT_OFFSET / OLED_PPB
						+ pos * OLED_FONT_WIDTH / OLED_PPB
						+ (OLED_FONT_HEIGHT - OLED_FONT_DOT_HEIGHT) * OLED_LINE_SIZE
						+ y * OLED_LINE_SIZE;
		*(uint16_t *)&oled_frame[x] = *(uint16_t *)ptr & font_color;
	}

	return 1;
}